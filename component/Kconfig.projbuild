## sdkconfig.defaults
```kconfig
CONFIG_APP_REPRODUCIBLE_BUILD=y

CONFIG_COMPILER_ASSERT_NDEBUG_EVALUATE=y
CONFIG_COMPILER_WARN_WRITE_STRINGS=y
CONFIG_COMPILER_CXX_EXCEPTIONS=y
CONFIG_COMPILER_CXX_RTTI=y

CONFIG_BOOTLOADER_LOG_LEVEL_DEBUG=y
CONFIG_BOOTLOADER_LOG_COLORS=y
CONFIG_LOG_MASTER_LEVEL=y
CONFIG_LOG_DEFAULT_LEVEL_INFO=y
CONFIG_LOG_MAXIMUM_LEVEL_VERBOSE=y

CONFIG_PARTITION_TABLE_OFFSET=0xA000

CONFIG_ESPTOOLPY_HEADER_FLASHSIZE_UPDATE=y
# On chips with USB serial, disable secondary console which does not make sense when using console component
CONFIG_ESP_CONSOLE_SECONDARY_NONE=y

CONFIG_ESP_SYSTEM_PANIC_REBOOT_DELAY_SECONDS=15

CONFIG_FREERTOS_USE_TRACE_FACILITY=y
CONFIG_FREERTOS_USE_STATS_FORMATTING_FUNCTIONS=y
```
