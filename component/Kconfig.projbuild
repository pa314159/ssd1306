## examples/random-fill/main/Kconfig.projbuild
```kconfig
menu "Demo App Configuration"
    orsource "$IDF_PATH/examples/common_components/env_caps/$IDF_TARGET/Kconfig.env_caps"

    menu "Display 0"
        choice
            prompt "Interface Type"
            default DISPLAY0_IIC
            help
                Select the interface type of display 0.
            config DISPLAY0_NIL
                bool "Not installed"
                help
                    IIC Interface.
            config DISPLAY0_IIC
                bool "IIC Interface"
                help
                    IIC Interface.
            config DISPLAY0_SPI
                bool "SPI Interface"
                help
                    SPI Interface.
        endchoice

        config DISPLAY0_TYPE
            int
            default 0 if DISPLAY0_NIL
            default 1 if DISPLAY0_IIC
            default 2 if DISPLAY0_SPI

        choice
            depends on DISPLAY0_IIC || DISPLAY0_SPI
            prompt "Panel Type"
            default DISPLAY0_128x64
            help
                Select Panel Type.
            config DISPLAY0_128xXX
                bool "Default Size"
                help
                    Use default panel size as set in SSD1306 menu.
            config DISPLAY0_128x32
                bool "128x32 Panel"
                help
                    Panel is 128x32.
            config DISPLAY0_128x64
                bool "128x64 Panel"
                help
                    Panel is 128x64.
        endchoice

        config DISPLAY0_PANEL_TYPE
            int
            default -1 if DISPLAY0_128xXX || DISPLAY0_NIL
            default 0 if SSD1306_128x32
            default 1 if SSD1306_128x64

        config DISPLAY0_FLIP_ON
            depends on DISPLAY0_IIC || DISPLAY0_SPI
            bool "Flip upside down"
            default false
            help
                Flip upside down.

        config DISPLAY0_FLIP
            int
            default 0 if !DISPLAY0_FLIP_ON
            default 1 if DISPLAY0_FLIP_ON

        config DISPLAY0_INVERT_ON
            depends on DISPLAY0_IIC || DISPLAY0_SPI
            bool "Invert colors"
            default false
            help
                Black is white and white is black.

        config DISPLAY0_INVERT
            int
            default 0 if !DISPLAY0_INVERT_ON
            default 1 if DISPLAY0_INVERT_ON

        config DISPLAY0_CONTRAST
            depends on DISPLAY0_IIC || DISPLAY0_SPI
            int "Display contrast"
            range 0 255
            default 63
            help
                Set the initial contrast of the display.

        config DISPLAY0_IIC_RST_PIN
            depends on DISPLAY0_IIC
            int "RESET GPIO number"
            range -1 ENV_GPIO_RANGE_MAX
            default -1
            help
                GPIO number (IOxx) to RESET. When it is -1, RESET isn't performed.

        config DISPLAY0_IIC_PORT
            depends on DISPLAY0_IIC
            int "IIC port that controls this bus"
            range 0 1
            default 0
            help
                Select IIC port that controls this bus.

        choice
            depends on DISPLAY0_IIC
            prompt "IIC address"
            default DISPLAY0_IIC_ADDRESS_3C

            config DISPLAY0_IIC_ADDRESS_3C
                bool "0x3C"
            config DISPLAY0_IIC_ADDRESS_3D
                bool "0x3D"
        endchoice

        config DISPLAY0_IIC_ADDRESS
            int
            default 60 if DISPLAY0_IIC_ADDRESS_3C
            default 61 if DISPLAY0_IIC_ADDRESS_3D

        config DISPLAY0_SPI_RST_PIN
            depends on DISPLAY0_SPI
            int "RESET GPIO number"
            range -1 ENV_GPIO_RANGE_MAX
            default 15 if IDF_TARGET_ESP32
            default 38 if IDF_TARGET_ESP32S2 || IDF_TARGET_ESP32S3
            default  4 # C3 and others
            help
                GPIO number (IOxx) to RESET. When it is -1, RESET isn't performed.

        config DISPLAY0_SPI_CS_PIN
            depends on DISPLAY0_SPI
            int "CS GPIO number"
            default  5 if IDF_TARGET_ESP32
            default 34 if IDF_TARGET_ESP32S2 || IDF_TARGET_ESP32S3
            default 10 # C3 and others
            help
                GPIO number (IOxx) to SPI CS.
    endmenu

    menu "Display 1"
        choice
            prompt "Interface Type"
            default DISPLAY1_NIL
            help
                Select the interface type of display 0.
            config DISPLAY1_NIL
                bool "Not installed"
                help
                    IIC Interface.
            config DISPLAY1_IIC
                bool "IIC Interface"
                help
                    IIC Interface.
            config DISPLAY1_SPI
                bool "SPI Interface"
                help
                    SPI Interface.
        endchoice

        choice
            depends on DISPLAY1_IIC || DISPLAY1_SPI
            prompt "Panel Type"
            default DISPLAY1_128x64
            help
                Select Panel Type.
            config DISPLAY1_128x32
                bool "128x32 Panel"
                help
                    Panel is 128x32.
            config DISPLAY1_128x64
                bool "128x64 Panel"
                help
                    Panel is 128x64.
        endchoice

        config DISPLAY1_PANEL_TYPE
            int
            default 0 if SSD1306_128x32
            default 1 if SSD1306_128x64

        config DISPLAY1_FLIP_ON
            depends on DISPLAY1_IIC || DISPLAY1_SPI
            bool "Flip upside down"
            default false
            help
                Flip upside down.

        config DISPLAY1_FLIP
            int
            default 0 if !DISPLAY1_FLIP_ON
            default 1 if DISPLAY1_FLIP_ON

        config DISPLAY1_INVERT_ON
            depends on DISPLAY1_IIC || DISPLAY1_SPI
            bool "Invert colors"
            default false
            help
                Black is white and white is black.

        config DISPLAY1_INVERT
            int
            default 0 if !DISPLAY1_INVERT_ON
            default 1 if DISPLAY1_INVERT_ON

        config DISPLAY1_CONTRAST
            depends on DISPLAY1_IIC || DISPLAY1_SPI
            int "Display contrast"
            range 0 255
            default 63
            help
                Set the initial contrast of the display.

        config DISPLAY1_TYPE
            int
            default 0 if DISPLAY1_NIL
            default 1 if DISPLAY1_IIC
            default 2 if DISPLAY1_SPI

        config DISPLAY1_IIC_RST_PIN
            depends on DISPLAY1_IIC
            int "RESET GPIO number"
            range -1 ENV_GPIO_RANGE_MAX
            default -1
            help
                GPIO number (IOxx) to RESET. When it is -1, RESET isn't performed.

        config DISPLAY1_IIC_PORT
            depends on DISPLAY1_IIC
            int "IIC port that controls this bus"
            range 0 1
            default 0
            help
                Select IIC port that controls this bus.

        choice
            depends on DISPLAY1_IIC
            prompt "IIC address"
            default DISPLAY1_IIC_ADDRESS_3C

            config DISPLAY1_IIC_ADDRESS_3C
                bool "0x3C"
            config DISPLAY1_IIC_ADDRESS_3D
                bool "0x3D"
        endchoice

        config DISPLAY1_IIC_ADDRESS
            int
            default 60 if DISPLAY1_IIC_ADDRESS_3C
            default 61 if DISPLAY1_IIC_ADDRESS_3D

        config DISPLAY1_SPI_RST_PIN
            depends on DISPLAY1_SPI
            int "RESET GPIO number"
            range -1 ENV_GPIO_RANGE_MAX
            default 15 if IDF_TARGET_ESP32
            default 38 if IDF_TARGET_ESP32S2 || IDF_TARGET_ESP32S3
            default  4 # C3 and others
            help
                GPIO number (IOxx) to RESET. When it is -1, RESET isn't performed.

        config DISPLAY1_SPI_CS_PIN
            depends on DISPLAY1_SPI
            int "CS GPIO number"
            default  5 if IDF_TARGET_ESP32
            default 34 if IDF_TARGET_ESP32S2 || IDF_TARGET_ESP32S3
            default 10 # C3 and others
            help
                GPIO number (IOxx) to SPI CS.
    endmenu
endmenu
```

## examples/random-fill/sdkconfig.defaults
```kconfig
CONFIG_APP_REPRODUCIBLE_BUILD=y

CONFIG_COMPILER_ASSERT_NDEBUG_EVALUATE=y
CONFIG_COMPILER_WARN_WRITE_STRINGS=y
CONFIG_COMPILER_CXX_EXCEPTIONS=y
CONFIG_COMPILER_CXX_RTTI=y

CONFIG_BOOTLOADER_LOG_LEVEL_DEBUG=y
CONFIG_BOOTLOADER_LOG_COLORS=y
CONFIG_LOG_COLORS=y
CONFIG_LOG_MASTER_LEVEL=n
CONFIG_LOG_DEFAULT_LEVEL_INFO=y
CONFIG_LOG_MAXIMUM_LEVEL_VERBOSE=y
CONFIG_LOG_TIMESTAMP_SOURCE_SYSTEM=y

CONFIG_PARTITION_TABLE_OFFSET=0xA000

CONFIG_ESPTOOLPY_HEADER_FLASHSIZE_UPDATE=y

CONFIG_ESP_SYSTEM_PANIC_REBOOT_DELAY_SECONDS=15

CONFIG_FREERTOS_USE_TRACE_FACILITY=y
CONFIG_FREERTOS_USE_STATS_FORMATTING_FUNCTIONS=y

CONFIG_SSD1306_FLIP=n
CONFIG_SSD1306_OPTIMIZE=n
CONFIG_SSD1306_SPI_PIN_MATCH=y

CONFIG_DISPLAY0_IIC=y
CONFIG_DISPLAY0_128x64=y
CONFIG_DISPLAY0_FLIP_ON=y
CONFIG_DISPLAY0_INVERT_ON=n
```

## examples/show-splash/sdkconfig.defaults
```kconfig
CONFIG_APP_REPRODUCIBLE_BUILD=y

CONFIG_ESPTOOLPY_HEADER_FLASHSIZE_UPDATE=y
CONFIG_ESP_SYSTEM_PANIC_REBOOT_DELAY_SECONDS=15

CONFIG_LOG_MAXIMUM_LEVEL_VERBOSE=y
CONFIG_LOG_COLORS=y
CONFIG_LOG_TIMESTAMP_SOURCE_SYSTEM=y

CONFIG_SSD1306_FLIP=y
CONFIG_SSD1306_OPTIMIZE=n
CONFIG_SSD1306_SPLASH=1500
```

## examples/status-text/sdkconfig.defaults
```kconfig
CONFIG_APP_REPRODUCIBLE_BUILD=y

CONFIG_COMPILER_ASSERT_NDEBUG_EVALUATE=y
CONFIG_COMPILER_WARN_WRITE_STRINGS=y

CONFIG_ESPTOOLPY_HEADER_FLASHSIZE_UPDATE=y
CONFIG_ESP_SYSTEM_PANIC_REBOOT_DELAY_SECONDS=15
# On chips with USB serial, disable secondary console which does not make sense when using console component
CONFIG_ESP_CONSOLE_SECONDARY_NONE=y

CONFIG_LOG_COLORS=y
CONFIG_LOG_MAXIMUM_LEVEL_VERBOSE=y

CONFIG_SSD1306_FLIP=y
CONFIG_SSD1306_OPTIMIZE=n
CONFIG_SSD1306_SPLASH=2500
CONFIG_SSD1306_FONT_CUSTOM=y
CONFIG_SSD1306_FONT_CUSTOM_NAME="cabaret"
```

## main/Kconfig.projbuild
```kconfig
menu "SSD1306 Configuration"
    orsource "$IDF_PATH/examples/common_components/env_caps/$IDF_TARGET/Kconfig.env_caps"

	config GPIO_RANGE_MAX
		int
		default 33 if IDF_TARGET_ESP32
		default 46 if IDF_TARGET_ESP32S2
		default 48 if IDF_TARGET_ESP32S3
		default 18 if IDF_TARGET_ESP32C2
		default 19 if IDF_TARGET_ESP32C3
		default 30 if IDF_TARGET_ESP32C6
		default 27 if IDF_TARGET_ESP32H2

    choice SSD1306_LOGGING_LEVEL
        bool "Logging level"
        default SSD1306_LOGGING_LEVEL_INFO

        config SSD1306_LOGGING_LEVEL_NONE
            bool "No output"
        config SSD1306_LOGGING_LEVEL_ERROR
            bool "Error"
        config SSD1306_LOGGING_LEVEL_WARN
            bool "Warning"
        config SSD1306_LOGGING_LEVEL_INFO
            bool "Info"
        config SSD1306_LOGGING_LEVEL_DEBUG
            bool "Debug"
        config SSD1306_LOGGING_LEVEL_VERBOSE
            bool "Verbose"
    endchoice

    config SSD1306_LOGGING_LEVEL
        int
        default 0 if SSD1306_LOGGING_LEVEL_NONE
        default 1 if SSD1306_LOGGING_LEVEL_ERROR
        default 2 if SSD1306_LOGGING_LEVEL_WARN
        default 3 if SSD1306_LOGGING_LEVEL_INFO
        default 4 if SSD1306_LOGGING_LEVEL_DEBUG
        default 5 if SSD1306_LOGGING_LEVEL_VERBOSE

    choice SSD1306_SIZE
        prompt "Panel Type"
        default SSD1306_128x64
        help
            Select Panel Type.
        config SSD1306_128x32
            bool "128x32 Panel"
            help
                Panel is 128x32.
        config SSD1306_128x64
            bool "128x64 Panel"
            help
                Panel is 128x64.
    endchoice

    config SSD1306_WIDTH
        int
        default 128

    config SSD1306_HEIGHT
        int
        default 32 if SSD1306_128x32
        default 64 if SSD1306_128x64

    config SSD1306_FLIP
        bool "Flip upside down"
        default false
        help
            Flip upside down.
                
    config SSD1306_FONT
        string "Embedded font"
        default "ib8x8u"
        help
            Embedded font name.

    config SSD1306_SPLASH
        bool "Splash screen"
        default true
        help
            Show a splash screen at startup.

    config SSD1306_PRIORITY
        int "Rendering priority"
        range 0 20
        default 10
        help
            The priority of the rendering task.

    config SSD1306_OPTIMIZE
        bool "Optimize rendering"
        default true
        help
            Update only changed area.
                        
    choice SSD1306_INTERFACE
        prompt "Interface"
        default SSD1306_I2C
        help
            Select Interface.
        config SSD1306_I2C
            bool "I2C Interface"
            help
                I2C Interface.
        config SSD1306_SPI
            bool "SPI Interface"
            help
                SPI Interface.
    endchoice

    config SSD1306_I2C_RST_PIN
        depends on SSD1306_I2C
        int "RESET GPIO number"
        range -1 GPIO_RANGE_MAX
        default -1
        help
            GPIO number (IOxx) to RESET. When it is -1, RESET isn't performed.

    config SSD1306_I2C_SCL_PIN
        depends on SSD1306_I2C
        int "SCL GPIO number"
        range 0 GPIO_RANGE_MAX
        default 22
        help
            GPIO number (IOxx) to I2C SCL.
            Some GPIOs are used for other purposes (flash connections, etc.) and cannot be used to I2C.
            GPIOs 35-39 are input-only so cannot be used as outputs.

    config SSD1306_I2C_SDA_PIN
        depends on SSD1306_I2C
        int "SDA GPIO number"
        range 0 GPIO_RANGE_MAX
        default 21
        help
            GPIO number (IOxx) to I2C SDA.

    config SSD1306_I2C_PORT
        depends on SSD1306_I2C
        int "I2C port that controls this bus"
        range 0 1
        default 0
        help
            Select I2C port that controls this bus.

    config SSD1306_I2C_FREQ
        depends on SSD1306_I2C
        int "I2C frequency (kHz)"
        default 400
        help
            Select I2C SCL line frequency in kHz.
            Defaults to 400 kHz, a known 'safe' value for most
            microcontrollers, and meets the SSD1306 datasheet spec.
            Some systems can operate I2C faster (800 kHz for ESP32, 1 MHz
            for many other 32-bit MCUs).

    config SSD1306_SPI_RST_PIN
        depends on SSD1306_SPI
        int "RESET GPIO number"
        range -1 GPIO_RANGE_MAX
        default 5
        help
            GPIO number (IOxx) to RESET. When it is -1, RESET isn't performed.
        
    config SSD1306_SPI_MOSI_PIN
        depends on SSD1306_SPI
        int "MOSI GPIO number"
        range 0 GPIO_RANGE_MAX
        default 18
        help
            GPIO number (IOxx) to SPI MOSI.

    config SSD1306_SPI_SCLK_PIN
        depends on SSD1306_SPI
        int "SCLK GPIO number"
        range 0 GPIO_RANGE_MAX
        default 19
        help
            GPIO number (IOxx) to SPI SCLK.

    config SSD1306_SPI_CS_PIN
        depends on SSD1306_SPI
        int "CS GPIO number"
        range 0 GPIO_RANGE_MAX
        default 16
        help
            GPIO number (IOxx) to SPI CS.

    config SSD1306_SPI_DC_PIN
        depends on SSD1306_SPI
        int "DC GPIO number"
        range 0 GPIO_RANGE_MAX
        default 17
        help
            GPIO number (IOxx) to SPI DC.

    config SSD1306_SPI_HOST
        depends on SSD1306_SPI
        int "SPI peripheral that controls this bus"
        range 0 1
        default 1
        help
            Select SPI peripheral that controls this bus.

    config SSD1306_SPI_FREQ
        depends on SSD1306_SPI
        int "SPI frequency (MHz)"
        default 1
        help
            Select SPI line frequency in MHz.

endmenu
```
