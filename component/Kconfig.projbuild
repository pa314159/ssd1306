## component/Kconfig.projbuild
```kconfig
menu "SSD1306 Configuration"
    orsource "$IDF_PATH/examples/common_components/env_caps/$IDF_TARGET/Kconfig.env_caps"

	config GPIO_RANGE_MAX
		int
		default 33 if IDF_TARGET_ESP32
		default 46 if IDF_TARGET_ESP32S2
		default 48 if IDF_TARGET_ESP32S3
		default 18 if IDF_TARGET_ESP32C2
		default 19 if IDF_TARGET_ESP32C3
		default 30 if IDF_TARGET_ESP32C6
		default 27 if IDF_TARGET_ESP32H2

    choice
        prompt "Logging level"
        default SSD1306_LOGGING_LEVEL_INFO

        config SSD1306_LOGGING_LEVEL_NONE
            bool "No output"
        config SSD1306_LOGGING_LEVEL_ERROR
            bool "Error"
        config SSD1306_LOGGING_LEVEL_WARN
            bool "Warning"
        config SSD1306_LOGGING_LEVEL_INFO
            bool "Info"
        config SSD1306_LOGGING_LEVEL_DEBUG
            bool "Debug"
        config SSD1306_LOGGING_LEVEL_VERBOSE
            bool "Verbose"
    endchoice

    config SSD1306_LOGGING_LEVEL
        int
        default 0 if SSD1306_LOGGING_LEVEL_NONE
        default 1 if SSD1306_LOGGING_LEVEL_ERROR
        default 2 if SSD1306_LOGGING_LEVEL_WARN
        default 3 if SSD1306_LOGGING_LEVEL_INFO
        default 4 if SSD1306_LOGGING_LEVEL_DEBUG
        default 5 if SSD1306_LOGGING_LEVEL_VERBOSE

    choice
        prompt "Panel Type"
        default SSD1306_128x64
        help
            Select Panel Type.
        config SSD1306_128x32
            bool "128x32 Panel"
            help
                Panel is 128x32.
        config SSD1306_128x64
            bool "128x64 Panel"
            help
                Panel is 128x64.
    endchoice

    config SSD1306_WIDTH
        int
        default 128

    config SSD1306_HEIGHT
        int
        default 32 if SSD1306_128x32
        default 64 if SSD1306_128x64

    config SSD1306_FLIP
        bool "Flip upside down"
        default false
        help
            Flip upside down.

    config SSD1306_INVERT
        bool "Invert colors"
        default false
        help
            Black is white and white is black.

    config SSD1306_CONTRAST
        int "Display contrast"
        range 0 255
        default 63
        help
            Set the initial contrast of the display.

    config SSD1306_FONT
        string "Embedded font"
        default "ib8x8u"
        help
            Embedded font name.

    config SSD1306_TEXT_INVERT
        int "Character code to switch colors"
        default 7
        range 1 31
        help
            Swap foreground and background colors.

    config SSD1306_SPLASH
        int "Splash screen duration"
        default 2500
        help
            For how many milliseconds to keep the splash screen visible at startup.

    config SSD1306_PRIORITY
        int "Rendering task priority"
        range 0 20
        default 10
        help
            The priority of the rendering task.

    config SSD1306_STACK_SIZE
        int "Rendering task stack size (kB)"
        default 4
        help
            The stack size of the rendering task.

    config SSD1306_OPTIMIZE
        bool "Optimize rendering (experimental)"
        default n
        help
            Update only changed area.
                        
    choice SSD1306_INTERFACE
        prompt "Default Interface"
        default SSD1306_I2C
        help
            Select the default interface to be returned by ssd1306_create_init.
        config SSD1306_I2C
            bool "I2C Interface"
            help
                I2C Interface.
        config SSD1306_SPI
            bool "SPI Interface"
            help
                SPI Interface.
    endchoice

    config SSD1306_I2C_RST_PIN
        depends on SSD1306_I2C
        int "RESET GPIO number"
        range -1 GPIO_RANGE_MAX
        default -1
        help
            GPIO number (IOxx) to RESET. When it is -1, RESET isn't performed.

    config SSD1306_I2C_SCL_PIN
        depends on SSD1306_I2C
        int "SCL GPIO number"
        range 0 GPIO_RANGE_MAX
		default 22 if IDF_TARGET_ESP32
		default  2 if IDF_TARGET_ESP32S2 || IDF_TARGET_ESP32S3 || IDF_TARGET_ESP32H2
		default  6 # C3 and others
        help
            GPIO number (IOxx) to I2C SCL.
            Some GPIOs are used for other purposes (flash connections, etc.) and cannot be used to I2C.
            GPIOs 35-39 are input-only so cannot be used as outputs.

    config SSD1306_I2C_SDA_PIN
        depends on SSD1306_I2C
        int "SDA GPIO number"
        range 0 GPIO_RANGE_MAX
		default 21 if IDF_TARGET_ESP32
		default  1 if IDF_TARGET_ESP32S2 || IDF_TARGET_ESP32S3 || IDF_TARGET_ESP32H2
		default  5 # C3 and others
        help
            GPIO number (IOxx) to I2C SDA.

    config SSD1306_I2C_PORT
        depends on SSD1306_I2C
        int "I2C port that controls this bus"
        range 0 1
        default 0
        help
            Select I2C port that controls this bus.

    config SSD1306_I2C_FREQ
        depends on SSD1306_I2C
        int "I2C frequency (kHz)"
        default 400
        help
            Select I2C SCL line frequency in kHz.
            Defaults to 400 kHz, a known 'safe' value for most
            microcontrollers, and meets the SSD1306 datasheet spec.
            Some systems can operate I2C faster (800 kHz for ESP32, 1 MHz
            for many other 32-bit MCUs).

    choice
        depends on SSD1306_I2C
        prompt "I2C address"
        default SSD1306_I2C_ADDRESS_3C

        config SSD1306_I2C_ADDRESS_3C
            bool "0x3C"
        config SSD1306_I2C_ADDRESS_3D
            bool "0x3D"
    endchoice

    config SSD1306_I2C_ADDRESS
        int
        default 60 if SSD1306_I2C_ADDRESS_3C
        default 61 if SSD1306_I2C_ADDRESS_3D

    config SSD1306_SPI_PIN_MATCH
        depends on SSD1306_SPI
        bool "Pins match connector order"
        help
            Custom PIN assignment matching the order of the SSD1306 connector pins.

            Pins are assigned starting with GPIO19 (pin 38) as follows:
                - D0 / SCLK -> GPIO19
                - D1 / MOSI -> GPIO18
                - RST       -> GPIO5
                - DC        -> GPIO17
                - CS        -> GPIO16

        default n

    config SSD1306_SPI_RST_GPIO
        depends on SSD1306_SPI && !SSD1306_SPI_PIN_MATCH
        int "RESET GPIO number"
        range -1 GPIO_RANGE_MAX
		default 15 if IDF_TARGET_ESP32
		default 38 if IDF_TARGET_ESP32S2 || IDF_TARGET_ESP32S3
		default  4 # C3 and others
        help
            GPIO number (IOxx) to RESET. When it is -1, RESET isn't performed.

    config SSD1306_SPI_RST_PIN
        depends on SSD1306_SPI
        int
        default 5 if SSD1306_SPI_PIN_MATCH
        default SSD1306_SPI_RST_GPIO if !SSD1306_SPI_PIN_MATCH

    config SSD1306_SPI_MOSI_GPIO
        depends on SSD1306_SPI && !SSD1306_SPI_PIN_MATCH
        int "D1 / MOSI GPIO number"
        range 0 GPIO_RANGE_MAX
		default 23 if IDF_TARGET_ESP32
		default 35 if IDF_TARGET_ESP32S2 || IDF_TARGET_ESP32S3
		default  1 # C3 and others
        help
            GPIO number (IOxx) to SPI MOSI.

    config SSD1306_SPI_MOSI_PIN
        depends on SSD1306_SPI
        int
        default 18 if SSD1306_SPI_PIN_MATCH
        default SSD1306_SPI_MOSI_GPIO if !SSD1306_SPI_PIN_MATCH

    config SSD1306_SPI_SCLK_GPIO
        depends on SSD1306_SPI && !SSD1306_SPI_PIN_MATCH
        int "D0 / SCLK GPIO number"
        range 0 GPIO_RANGE_MAX
		default 18 if IDF_TARGET_ESP32
		default 36 if IDF_TARGET_ESP32S2 || IDF_TARGET_ESP32S3
		default  2 # C3 and others
        help
            GPIO number (IOxx) to SPI SCLK.

    config SSD1306_SPI_SCLK_PIN
        depends on SSD1306_SPI
        int
        default 19 if SSD1306_SPI_PIN_MATCH
        default SSD1306_SPI_SCLK_GPIO if !SSD1306_SPI_PIN_MATCH

    config SSD1306_SPI_CS_GPIO
        depends on SSD1306_SPI && !SSD1306_SPI_PIN_MATCH
        int "CS GPIO number"
		default  5 if IDF_TARGET_ESP32
		default 34 if IDF_TARGET_ESP32S2 || IDF_TARGET_ESP32S3
		default 10 # C3 and others
        help
            GPIO number (IOxx) to SPI CS.

    config SSD1306_SPI_CS_PIN
        depends on SSD1306_SPI
        int
        default 16 if SSD1306_SPI_PIN_MATCH
        default SSD1306_SPI_CS_GPIO if !SSD1306_SPI_PIN_MATCH

    config SSD1306_SPI_DC_GPIO
        depends on SSD1306_SPI && !SSD1306_SPI_PIN_MATCH
        int "DC GPIO number"
        range 0 GPIO_RANGE_MAX
		default  4 if IDF_TARGET_ESP32
		default 37 if IDF_TARGET_ESP32S2 || IDF_TARGET_ESP32S3
		default  3 # C3 and others
        help
            GPIO number (IOxx) to SPI DC.

    config SSD1306_SPI_DC_PIN
        depends on SSD1306_SPI
        int
        default 17 if SSD1306_SPI_PIN_MATCH
        default SSD1306_SPI_DC_GPIO if !SSD1306_SPI_PIN_MATCH

    config SSD1306_SPI_HOST
        depends on SSD1306_SPI
        int "SPI peripheral that controls this bus"
        range 0 1
        default 1
        help
            Select SPI peripheral that controls this bus.

    config SSD1306_SPI_FREQ
        depends on SSD1306_SPI
        int "SPI frequency (MHz)"
        default 1
        help
            Select SPI line frequency in MHz.

endmenu
```

## examples/nopnop2002/sdkconfig.defaults
```kconfig
CONFIG_APP_REPRODUCIBLE_BUILD=y

CONFIG_ESPTOOLPY_HEADER_FLASHSIZE_UPDATE=y
CONFIG_ESP_SYSTEM_PANIC_REBOOT_DELAY_SECONDS=15

CONFIG_LOG_DEFAULT_LEVEL_VERBOSE=y
CONFIG_LOG_MAXIMUM_LEVEL_VERBOSE=y
CONFIG_LOG_COLORS=y

CONFIG_SPI_INTERFACE=y
CONFIG_FLIP=y
CONFIG_MOSI_GPIO=18
CONFIG_SCLK_GPIO=19
CONFIG_CS_GPIO=16
CONFIG_DC_GPIO=17
CONFIG_RESET_GPIO=5
CONFIG_SPI3_HOST=y
```
